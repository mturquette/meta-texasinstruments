## conf/distro/fremantle-compat.conf
```bitbake
#@TYPE: Distribution#@NAME: tilinux
#@DESCRIPTION: Distribution configuration for OpenedHand (TI Linux Poky)

DISTRO = "fremantle-compat"
DISTRO_NAME = "Maemo 5.0 (Fremantle) Compatibility Distribution"

MAINTAINER = "Texas Instruments, Mike Turquette <mturquette@ti.com>"

#require conf/distro/include/versions-23.11.inc

PACKAGE_CLASSES ?= "package_ipk"
INHERIT_INSANE ?= "insane"
INHERIT += "${PACKAGE_CLASSES} debian poky devshell ${INHERIT_INSANE} packaged-staging"
# For some reason, this doesn't work
# TARGET_OS ?= "linux"
# TARGET_VENDOR ?= "-poky"
# Set by POKYMODE instead
TARGET_OS = "linux"
TARGET_FPU_arm ?= "soft"
TARGET_FPU_armeb ?= "soft"
TARGET_FPU_nokia800 = "hard"
TARGET_FPU_omap-3430sdp = "hard"
TARGET_FPU_omap-3430ldp = "hard"

QA_LOGFILE = "${TMPDIR}/qa.log"

IMAGE_ROOTFS_SIZE_ext2 ?= "131072"
IMAGE_ROOTFS_SIZE_jffs2 ?= "131072"

# Poky is svn based
METADATA_REVISION = "${@base_get_metadata_svn_revision(d)}"

ASSUME_PROVIDED += "virtual/arm-linux-gcc-2.95"
OEINCLUDELOGS = "yes"
KERNEL_CONSOLE = "ttyS0"
KERNEL_CONSOLE_omap-3430ldp = "ttyS2"
#DEBUG_OPTIMIZATION = "-O -g3"
#DEBUG_BUILD = "1"
#INHIBIT_PACKAGE_STRIP = "1"

# Default to TARGETOS values for EABI
GLIBCTARGETOS = "linux${@['','-gnueabi'][bb.data.getVar('TARGET_ARCH',d,1) in ['arm', 'armeb']]}"
UCLIBCTARGETOS = "linux${@['-uclibc','-uclibcgnueabi'][bb.data.getVar('TARGET_ARCH',d,1) in ['arm', 'armeb']]}"

POKYMODE ?= "eabi"
require conf/distro/include/poky-${POKYMODE}.inc

POKYLIBC ?= "glibc"
require conf/distro/include/poky-${POKYLIBC}.inc

SDK_NAME = "${DISTRO}-${POKYMODE}-${POKYLIBC}-${HOST_ARCH}-${TARGET_ARCH}"
SDK_PREFIX = "/usr/local/${DISTRO}/${POKYMODE}-${POKYLIBC}/${TARGET_ARCH}"

CACHE = "${TMPDIR}/cache/${POKYMODE}-${POKYLIBC}${@['', '/' + str(bb.data.getVar('MACHINE', d, 1))][bool(bb.data.getVar('MACHINE', d, 1))]}"

#
# Preferred providers:
#

# Virtuals:
PREFERRED_PROVIDER_virtual/db ?= "db"
PREFERRED_PROVIDER_virtual/db-native ?= "db-native"
PREFERRED_PROVIDER_virtual/xserver ?= "xserver-kdrive"
PREFERRED_PROVIDER_virtual/update-alternatives ?= "update-alternatives-cworth"
PREFERRED_PROVIDER_virtual/update-alternatives-native ?= "opkg-native"
#PREFERRED_PROVIDER_virtual/libx11 ?= "libx11-diet"
PREFERRED_PROVIDER_virtual/libx11 ?= "libx11"

VIRTUAL-RUNTIME_update-alternatives ?= "update-alternatives-cworth"

# Others:
PREFERRED_PROVIDER_linux-libc-headers ?= "linux-libc-headers"
PREFERRED_PROVIDER_dbus-glib ?= "dbus-glib"
PREFERRED_PROVIDER_dbus-glib-native ?= "dbus-glib-native"
PREFERRED_PROVIDER_gconf ?= "gconf-dbus"
PREFERRED_PROVIDER_matchbox-panel ?= "matchbox-panel-2"
PREFERRED_PROVIDER_opkg ?= "opkg"

require conf/distro/include/poky-fixed-revisions.inc
require conf/distro/include/preferred-xorg-versions.inc
require conf/distro/include/preferred-xorg-versions.inc

PCMCIA_MANAGER ?= "pcmciautils"

CVS_TARBALL_STASH += "http://www.o-hand.com/~richard/poky/sources/"

IMAGE_LINGUAS ?= "en-us"
LIMIT_BUILT_LOCALES ?= "en_US"
ENABLE_BINARY_LOCALE_GENERATION ?= "0"
LOCALE_UTF8_ONLY = "1"

DISTRO_FEATURES = "alsa bluetooth ext2 irda pcmcia usbgadget usbhost wifi nfs zeroconf pci"

POKY_EXTRA_RDEPENDS = "task-poky-boot"

DISTRO_EXTRA_RDEPENDS += "${POKY_EXTRA_RDEPENDS}"
DISTRO_EXTRA_RRECOMMENDS += "kernel-module-af-packet"

IMAGE_FEATURES ?= ""

require conf/distro/include/world-broken.inc
```

## conf/distro/include/distro-features.inc
```bitbake
# These distro features change the build options of some components
# across the TI Linux distribution.
#
# Possible features are:
# * 720p	- Enable 720p OpenMAX components, kernel.
# * gfx		- Include 3D GFX module and libraries.
# * tiwifi	- Include support for TI's WLAN stack.
# * tibluetooth	- Include support for TI's Bluetooth and FM stack.
# * gps		- Include support for TI's GPS
# * rarv        - Enable readaudio/realvideo codecs
# * testpatterns - Include OMX test patterns

# The following are standard Poky DISTRO_FEATURES, not specific to
# OMAP.  Do not touch these unless you know what you are doing.

DISTRO_FEATURES += "alsa bluetooth ext2 irda pcmcia usbgadget usbhost wifi nfs zeroconf pci"

# Below are OMAP-specific DISTRO_FEATURES.  Hack away!
# This is a multimedia-based distribution. We can specify what
# codecs to enable in this release.

DISTRO_FEATURES += "camera jpegdec jpegenc gfx 720p rarv tibluetooth tiwifii gps"
```

## conf/distro/include/fremantle.inc
```bitbake
# various Maemo4 specific libraries
PREFERRED_VERSION_mce-dev = "1.6.3"
PREFERRED_VERSION_libosso = "2.13"
PREFERRED_VERSION_libhildon = "1.99.0"
PREFERRED_VERSION_libhildonmime = "1.10.0"
PREFERRED_VERSION_libhildonfm = "1.9.46"
PREFERRED_VERSION_hildon-thumbnail = "0.14"
PREFERRED_VERSION_osso-gwconnect = "1.0.12"
PREFERRED_VERSION_osso-gnome-vfs2 = "2.16.3"

# Java stuff 
PREFERRED_PROVIDER_midpath = "midpath-maemo"
PREFERRED_PROVIDER_midpath-backend-gtk = "midpath-backend-gtk-hildon"

# Need jamvm-initial since cacao 0.98 seems to get miscompiled with newer GCCs.
PREFERRED_PROVIDER_virtual/java-initial = "jamvm-initial"

PREFERRED_PROVIDER_virtual/javac-native = "ecj-bootstrap-native"

PREFERRED_PROVIDER_classpath = "classpath"
PREFERRED_VERSION_classpath = "0.97.2"

PREFERRED_PROVIDER_swt3.4-gtk = "swt3.4-gtk-hildon"
PREFERRED_VERSION_swt3.4-gtk-hildon = "3.4"
```

## conf/distro/include/versions-0.1.inc
```bitbake
# baseport
#PREFERRED_VERSION_x-load =		"4.60"
#PREFERRED_VERSION_u-boot =		"5.07"
#PREFERRED_VERSION_linux-tiomap =	"git"

# bridge and friends
#PREFERRED_VERSION_tidspbridge-module =	"23.12"
PREFERRED_VERSION_tidspbridge-lib =	"git"
PREFERRED_VERSION_tidspbridge-samples =	"4.52-P1"

# openmax
#PREFERRED_PROVIDER_virtual/openmax-il =		"meta-tiopenmax"
PREFERRED_PROVIDER_virtual/openmax-il =		"meta-tiopenmax-complete"
#PREFERRED_VERSION_tiopenmax =			"3.18"
PREFERRED_VERSION_tiopenmax-core =		"3.18"
PREFERRED_VERSION_tiopenmax-clock =		"3.18"
PREFERRED_VERSION_tiopenmax-perf =		"3.18"
PREFERRED_VERSION_tiopenmax-lcml =		"3.18"
PREFERRED_VERSION_tiopenmax-policymanager =	"3.18"
PREFERRED_VERSION_tiopenmax-audiomanager =	"3.18"
PREFERRED_VERSION_tiopenmax-resourcemanager =	"3.18"
PREFERRED_VERSION_tiopenmax-jpegdec =		"3.18"
PREFERRED_VERSION_tiopenmax-jpegenc =		"3.18"

# gstreamer
PREFERRED_VERSION_libgoo =		"5.11"
PREFERRED_VERSION_gst-goo =		"5.11"
PREFERRED_VERSION_gst-pyapps =		"5.11"

# connectivity
PREFERRED_VERSION_wilink = 		"23-1.1"
PREFERRED_VERSION_btfm = 		"23-1.1"
PREFERRED_VERSION_openobex =		"1.3"

# gfx
PREFERRED_VERSION_sgx-kernel-module =	"1.3"
PREFFERED_VERSION_sgx-lib-noxws =	"1.3"
```

## conf/distro/include/versions-12.20.inc
```bitbake
PREFERRED_VERSION_tidspbridge-module = "12.20"
PREFERRED_VERSION_tidspbridge-lib =    "12.20"
PREFERRED_VERSION_tidspbridge-extra =  "12.20"
PREFERRED_VERSION_tisocketnodes =      "12.20"
PREFERRED_VERSION_tiopenmax =          "12.20"
PREFERRED_VERSION_libgoo =             "4.20"
PREFERRED_VERSION_gst-goo =            "4.20"
PREFERRED_VERSION_tisocketnodes =      "12.20"
```

## conf/distro/include/versions-23.10.inc
```bitbake
# baseport
PREFERRED_VERSION_u-boot =             "23.10"
PREFERRED_VERSION_linux-tiomap =       "2.6.24.7"

# bridge and friends
PREFERRED_VERSION_tidspbridge-module = "23.10"
PREFERRED_VERSION_tidspbridge-lib =    "23.10"
PREFERRED_VERSION_tidspbridge-extra =  "23.10"
PREFERRED_VERSION_tisocketnodes =      "23.10"

# openmax
PREFERRED_VERSION_tiopenmax =          "23.10"

# gstreamer
PREFERRED_VERSION_libgoo =             "5.10"
PREFERRED_VERSION_gst-goo =            "5.10"
```

## conf/distro/include/versions-23.11.inc
```bitbake
# baseport
PREFERRED_VERSION_x-load =		"4.59"
PREFERRED_VERSION_u-boot =		"5.06"
PREFERRED_VERSION_linux-tiomap =	"2.6.24.7-5.19"

# bridge and friends
PREFERRED_VERSION_tidspbridge-module =	"23.11"
PREFERRED_VERSION_tidspbridge-lib =	"23.11"

# openmax
PREFERRED_VERSION_tiopenmax =		"3.17"

# gstreamer
PREFERRED_VERSION_libgoo =		"5.11"
PREFERRED_VERSION_gst-goo =		"5.11"
PREFERRED_VERSION_gst-pyapps =		"5.11"

# connectivity
PREFERRED_VERSION_wilink = 		"23-1.1"
PREFERRED_VERSION_btfm = 		"23-1.1"
```

## conf/distro/include/versions-23.12.inc
```bitbake
# baseport
PREFERRED_VERSION_x-load =		"4.60"
PREFERRED_VERSION_u-boot =		"5.07"
PREFERRED_VERSION_linux-tiomap =	"2.6.24.7-5.20"

# bridge and friends
PREFERRED_VERSION_tidspbridge-module =	"23.12"
PREFERRED_VERSION_tidspbridge-lib =	"23.12"
PREFERRED_VERSION_tidspbridge-samples =	"4.52-P1"

# openmax
#PREFERRED_PROVIDER_virtual/openmax-il =		"meta-tiopenmax"
PREFERRED_PROVIDER_virtual/openmax-il =		"meta-tiopenmax-complete"
PREFERRED_VERSION_tiopenmax =			"3.17"
PREFERRED_VERSION_tiopenmax-core =		"3.17"
PREFERRED_VERSION_tiopenmax-clock =		"3.17"
PREFERRED_VERSION_tiopenmax-perf =		"3.17"
PREFERRED_VERSION_tiopenmax-lcml =		"3.17"
PREFERRED_VERSION_tiopenmax-policymanager =	"3.17"
PREFERRED_VERSION_tiopenmax-audiomanager =	"3.17"
PREFERRED_VERSION_tiopenmax-resourcemanager =	"3.17"
PREFERRED_VERSION_tiopenmax-jpegdec =		"3.17"
PREFERRED_VERSION_tiopenmax-jpegenc =		"3.17"

# gstreamer
PREFERRED_VERSION_libgoo =		"5.11"
PREFERRED_VERSION_gst-goo =		"5.11"
PREFERRED_VERSION_gst-pyapps =		"5.11"

# connectivity
PREFERRED_VERSION_wilink = 		"23-1.1"
PREFERRED_VERSION_btfm = 		"23-1.1"
PREFERRED_VERSION_openobex =            "1.3"

# gfx
PREFERRED_VERSION_sgx-kernel-module =	"1.3"
PREFFERED_VERSION_sgx-lib-noxws =	"1.3"
```
