## conf/distro/include/versions-23.16.inc
```bitbake
# tasks and images
PREFERRED_VERSION_task-omap-bridge.bb =			"1.0"
PREFERRED_VERSION_task-omap-connectivity.bb =		"1.0"
PREFERRED_VERSION_task-omap-gfx.bb =			"1.0"
PREFERRED_VERSION_task-omap-gst.bb =			"1.0"
PREFERRED_VERSION_task-omap-omx.bb =			"1.0"
PREFERRED_VERSION_task-omap-sn.bb =			"1.0"
PREFERRED_VERSION_task-omap-test.bb =			"1.0"
PREFERRED_VERSION_omap-image-minimal-mtdutils.bb =	"1.0"
PREFERRED_VERSION_omap-image-minimal.bb =		"1.0"
PREFERRED_VERSION_omap-image-mm.bb =			"1.0"
PREFERRED_VERSION_omap-image-sato.bb =			"1.0

# baseport
PREFERRED_VERSION_x-load =		"4.62"
PREFERRED_VERSION_u-boot =		"5.10"
PREFERRED_VERSION_linux-tiomap =	"2.6.24.7-5.24"

# bridge and friends
PREFERRED_VERSION_tidspbridge-module =		"23.16"
PREFERRED_VERSION_tidspbridge-lib =		"23.16"
PREFERRED_VERSION_tidspbridge-samples =		"4.54"
PREFERRED_VERSION_tidspbridge-extra =		"23.13"
PREFERRED_VERSION_tidspbridge-cgt6x =		"6.0.7"
PREFERRED_VERSION_tidspbridge-bios =		"5.33.02"
PREFERRED_VERSION_tidspbridge-dllcreate-native =	"23.11"

# baseimage
PREFERRED_VERSION_baseimage-masterconfig =		"23.x"
PREFERRED_VERSION_baseimage =				"1.0"
PREFERRED_VERSION_baseimage-avsync =			"1.0"
PREFERRED_VERSION_baseimage-dasf =			"1.0"
PREFERRED_VERSION_baseimage-hal =			"1.0"
PREFERRED_VERSION_baseimage-inst2 =			"1.0"
PREFERRED_VERSION_baseimage-make-system =		"1.0"
PREFERRED_VERSION_baseimage-samplerateconverter =	"1.0"
PREFERRED_VERSION_baseimage-tmon =			"1.0"
PREFERRED_VERSION_baseimage-utils =			"1.0"
PREFERRED_VERSION_baseimage-vgpop =			"3.02"

# socket nodes and codecs
PREFERRED_VERSION_tisocketnode-algo =			"3.02"
PREFERRED_VERSION_tisocketnode-dfgm =			"3.02"
PREFERRED_VERSION_tisocketnode-usn =			"3.02"
PREFERRED_VERSION_tisocketnode-control-task =		"3.40"
PREFERRED_VERSION_tisocketnode-vpp =			"3.02"
PREFERRED_VERSION_tisocketnode-ringio =			"3.02"
#
PREFERRED_VERSION_tisocketnode-mp3 =                    "3.02"
PREFERRED_VERSION_tisocketnode-mp3-codec =              "3.02"
PREFERRED_VERSION_tisocketnode-mpeg4aacdec =            "3.02"
PREFERRED_VERSION_tisocketnode-mpeg4aacdec-codec =      "3.02"
PREFERRED_VERSION_tisocketnode-mpeg4aacenc =            "3.02"
PREFERRED_VERSION_tisocketnode-mpeg4aacenc-codec =      "3.02"
PREFERRED_VERSION_tisocketnode-wma9 =                   "3.02"
PREFERRED_VERSION_tisocketnode-wma9-codec =             "3.02"
PREFERRED_VERSION_tisocketnode-pcmdec =                 "3.02"
PREFERRED_VERSION_tisocketnode-pcmenc =                 "3.02"
PREFERRED_VERSION_tisocketnode-ima-adpcmdec =           "3.02"
PREFERRED_VERSION_tisocketnode-ima-adpcmdec-codec =     "3.02"
PREFERRED_VERSION_tisocketnode-ima-adpcmenc =           "3.02"
PREFERRED_VERSION_tisocketnode-ima-adpcmenc-codec =     "3.02"
PREFERRED_VERSION_tisocketnode-nbamrdec =               "3.02"
PREFERRED_VERSION_tisocketnode-nbamrdec-codec =         "3.02"
PREFERRED_VERSION_tisocketnode-nbamrenc =               "3.02"
PREFERRED_VERSION_tisocketnode-nbamrenc-codec =         "3.02"
PREFERRED_VERSION_tisocketnode-wbamrdec =               "3.02"
PREFERRED_VERSION_tisocketnode-wbamrdec-codec =         "3.02"
PREFERRED_VERSION_tisocketnode-wbamrenc =               "3.02"
PREFERRED_VERSION_tisocketnode-wbamrenc-codec =         "3.02"
PREFERRED_VERSION_tisocketnode-gsmfrdec =               "3.02"
PREFERRED_VERSION_tisocketnode-gsmfrdec-codec =         "3.02"
PREFERRED_VERSION_tisocketnode-gsmfrenc =               "3.02"
PREFERRED_VERSION_tisocketnode-gsmfrenc-codec =         "3.02"
PREFERRED_VERSION_tisocketnode-gsmhrdec =               "3.02"
PREFERRED_VERSION_tisocketnode-gsmhrdec-codec =         "3.02"
PREFERRED_VERSION_tisocketnode-gsmhrenc =               "3.02"
PREFERRED_VERSION_tisocketnode-gsmhrenc-codec =         "3.02"
PREFERRED_VERSION_tisocketnode-g711dec =		"3.02"
PREFERRED_VERSION_tisocketnode-g711dec-codec =		"3.02"
PREFERRED_VERSION_tisocketnode-nmu-plc-vad =            "3.02"
PREFERRED_VERSION_tisocketnode-g711enc =		"3.02"
PREFERRED_VERSION_tisocketnode-g711enc-codec =		"3.02"
PREFERRED_VERSION_tisocketnode-g722dec =		"3.02"
PREFERRED_VERSION_tisocketnode-g722dec-codec =		"3.02"
PREFERRED_VERSION_tisocketnode-g722enc =		"3.02"
PREFERRED_VERSION_tisocketnode-g722enc-codec =		"3.02"
PREFERRED_VERSION_tisocketnode-g723dec =		"3.02"
PREFERRED_VERSION_tisocketnode-g723dec-codec =		"3.02"
PREFERRED_VERSION_tisocketnode-g723enc =		"3.02"
PREFERRED_VERSION_tisocketnode-g723enc-codec =		"3.02"
PREFERRED_VERSION_tisocketnode-g726dec =		"3.02"
PREFERRED_VERSION_tisocketnode-g726dec-codec =		"3.02"
PREFERRED_VERSION_tisocketnode-g726enc =		"3.02"
PREFERRED_VERSION_tisocketnode-g726enc-codec =		"3.02"
PREFERRED_VERSION_tisocketnode-g729dec =		"3.02"
PREFERRED_VERSION_tisocketnode-g729dec-codec =		"3.02"
PREFERRED_VERSION_tisocketnode-g729enc =		"3.02"
PREFERRED_VERSION_tisocketnode-g729enc-codec =		"3.02"
PREFERRED_VERSION_tisocketnode-ilbcdec =		"3.02"
PREFERRED_VERSION_tisocketnode-ilbcdec-codec =		"3.02"
PREFERRED_VERSION_tisocketnode-ilbcenc =		"3.02"
PREFERRED_VERSION_tisocketnode-ilbcenc-codec =		"3.02"
PREFERRED_VERSION_tisocketnode-rageckodec =             "3.02"
PREFERRED_VERSION_tisocketnode-rageckodec-codec =       "3.02"
#
PREFERRED_VERSION_tisocketnode-h264dec =                "3.02"
PREFERRED_VERSION_tisocketnode-h264dec-codec =          "3.02"
PREFERRED_VERSION_tisocketnode-h264enc =                "3.02"
PREFERRED_VERSION_tisocketnode-h264enc-codec =          "3.02"
PREFERRED_VERSION_tisocketnode-mpeg4dec =               "3.02"
PREFERRED_VERSION_tisocketnode-mpeg4dec-codec =         "3.02"
PREFERRED_VERSION_tisocketnode-mpeg4enc =               "3.02"
PREFERRED_VERSION_tisocketnode-mpeg4enc-codec =         "3.02"
PREFERRED_VERSION_tisocketnode-mpeg4-720pdec =          "3.02"
PREFERRED_VERSION_tisocketnode-mpeg4-720pdec-codec =    "3.02"
PREFERRED_VERSION_tisocketnode-mpeg4-720penc =          "3.02"
PREFERRED_VERSION_tisocketnode-mpeg4-720penc-codec =    "3.02"
PREFERRED_VERSION_tisocketnode-mpeg2 =                  "3.02"
PREFERRED_VERSION_tisocketnode-mpeg2-codec =            "3.02"
PREFERRED_VERSION_tisocketnode-wmv9 =                   "3.02"
PREFERRED_VERSION_tisocketnode-wmv9-codec =             "3.02"
PREFERRED_VERSION_tisocketnode-mpeg2 =                  "3.02"
PREFERRED_VERSION_tisocketnode-mpeg2-codec =            "3.02"
PREFERRED_VERSION_tisocketnode-spark =                  "3.02"
PREFERRED_VERSION_tisocketnode-spark-codec =            "3.02"
PREFERRED_VERSION_tisocketnode-rv89combodec =           "3.02"
PREFERRED_VERSION_tisocketnode-rv89combodec-codec =     "3.02"
#
PREFERRED_VERSION_tisocketnode-ipp =                    "3.02"
#
PREFERRED_VERSION_tisocketnode-jpegdec =                "3.02"
PREFERRED_VERSION_tisocketnode-jpegdec-codec =          "3.02"
PREFERRED_VERSION_tisocketnode-jpegenc =                "3.02"
PREFERRED_VERSION_tisocketnode-jpegenc-codec =          "3.02"
#

# openmax
#PREFERRED_PROVIDER_virtual/openmax-il =		"meta-tiopenmax-modular"
PREFERRED_PROVIDER_virtual/openmax-il =		"meta-tiopenmax-monolithic"
PREFERRED_VERSION_tiopenmax =			"3.22-pre"
PREFERRED_VERSION_tiopenmax-core =		"3.21"
PREFERRED_VERSION_tiopenmax-clock =		"3.21"
PREFERRED_VERSION_tiopenmax-perf =		"3.21"
PREFERRED_VERSION_tiopenmax-lcml =		"3.21"
PREFERRED_VERSION_tiopenmax-policymanager =	"3.21"
PREFERRED_VERSION_tiopenmax-audiomanager =	"3.21"
PREFERRED_VERSION_tiopenmax-resourcemanager =	"3.21"
PREFERRED_VERSION_tiopenmax-jpegdec =		"3.21"
PREFERRED_VERSION_tiopenmax-jpegenc =		"3.21"
PREFERRED_VERSION_tiopenmax-cspec = 		"3.21"
PREFERRED_VERSION_mm-isp =			"1.14"

# gstreamer
PREFERRED_VERSION_libgoo =		"5.16-rc3"
PREFERRED_VERSION_gst-goo =		"5.16-rc5"
PREFERRED_VERSION_gst-pyapps =		"5.15"

# connectivity
PREFERRED_VERSION_wilink = 		"23-15"
PREFERRED_VERSION_btfm = 		"23.15.0"
PREFERRED_VERSION_fmapp = 		"23.15.0-P1"

# graphics
PREFERRED_VERSION_sgx-kernel-module =	"1.3.2.3"
PREFFERED_VERSION_sgx-lib-noxws =	"1.3.2.3"

# open source dependencies
PREFERRED_VERSION_gst-plugins-bad =	"0.10.8"
PREFERRED_VERSION_gst-plugins-ugly =	"0.10.9"
PREFERRED_VERSION_gst-plugins-good =	"0.10.7"
PREFERRED_VERSION_gst-qtmux =		"svn"
PREFERRED_VERSION_check =		"0.9.5"
PREFERRED_VERSION_amrnb =		"7.0.0.2"
PREFERRED_VERSION_amrwb =		"7.0.0.1"
#PREFERRED_VERSION_openobex =		"0.22"
PREFERRED_VERSION_bison-1.875 =		"1.875"
PREFERRED_VERSION_bison-native-1.875 =	"1.875"
PREFERRED_VERSION_flex =		"2.5.35"
PREFERRED_VERSION_flex-native =		"2.5.35"
PREFERRED_VERSION_iperf =		"2.0.4"
PREFERRED_VERSION_libmms =		"0.3"

# toolchain
PREFERRED_VERSION_external-csl-toolchain =	"2008q3-72"

# test
PREFERRED_VERSION_cheese	=	"2.24.3"
PREFERRED_VERSION_intltool	=	"0.40.0"

# extra (will be replaced by pokyomap in subsequent releases)
PREFERRED_VERSION_gtk+		=	"2.14.7"
PREFERRED_VERSION_glib-2.0	=	"2.18.4"
PREFERRED_VERSION_pango		=	"1.22.4"
PREFERRED_VERSION_cairo		=	"1.8.6"
PREFERRED_VERSION_pixman	=	"0.14.0"
```

## conf/machine/beagleboard.conf
```bitbake
#@TYPE: Machine
#@NAME: TI OMAP 3530 Beagleboard
#@DESCRIPTION: Machine configuration for the TI OMAP 3530 SDP
TARGET_ARCH = "arm"
PACKAGE_EXTRA_ARCHS = "armv4 armv4t armv5te armv6 armv7a"

#PREFERRED_PROVIDER_virtual/kernel = "linux-tiomap"
PREFERRED_PROVIDER_virtual/kernel = "linux-omap3"
PREFERRED_PROVIDER_virtual/dspbridge-module = "linux-omap3"

MACHINE_FEATURES = "kernel26 apm alsa bluetooth"
KERNEL_IMAGETYPE = "uImage"
IMAGE_FSTYPES ?= "tar.gz jffs2"
EXTRA_IMAGECMD_jffs2 = "--pad --little-endian --eraseblock=0x20000 -n"
SERIAL_CONSOLE = "-L 115200 ttyS2"
MACHINE_ESSENTIAL_EXTRA_RRECOMMENDS = "u-boot-omap3"

require conf/machine/include/tune-cortexa8.inc
#require conf/machine/include/tune-arm1136jf-s.inc
```

## conf/machine/omap-zoom2-beta.conf
```bitbake
#@TYPE: Machine
#@NAME: TI OMAP 3430 Zoom2
#@DESCRIPTION: Machine config for TI OMAP 3430 Zoom2 (beta, full plastics)
TARGET_ARCH = "arm"
PACKAGE_EXTRA_ARCHS = "armv4 armv4t armv5te armv6 armv7a"

PREFERRED_PROVIDER_virtual/kernel = "linux-tiomap"
#PREFERRED_VERSION_linux-tiomap = "git"

MACHINE_FEATURES = "kernel26 apm alsa bluetooth screen touchscreen phone"
#MACHINE_FEATURES = "accelerometer camera fm"
KERNEL_IMAGETYPE = "uImage"
IMAGE_FSTYPES ?= "tar.gz jffs2"
EXTRA_IMAGECMD_jffs2 = "--pad --little-endian --eraseblock=0x20000 -n"
SERIAL_CONSOLE = "-L 115200 ttyS3"
MACHINE_ESSENTIAL_EXTRA_RRECOMMENDS = "u-boot x-load"

require conf/machine/include/tune-cortexa8.inc

MACHINE_EXTRA_RRECOMMENDS = "\
	kernel-module-ads7846 \
	kernel-module-atkbd \
	kernel-module-g-ether \
	kernel-module-musb-hdrc \
	kernel-module-omap24xxlib \
	kernel-module-omap24xxvout \
	kernel-module-omap-hsmmc \
	kernel-module-snd-omap2-audio \
	"
```
